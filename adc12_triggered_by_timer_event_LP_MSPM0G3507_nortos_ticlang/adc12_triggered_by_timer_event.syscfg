/**
 * @cliArgs --device "MSPM0G350X" --part "Default" --package "LQFP-64(PM)" --product "mspm0_sdk@2.05.01.01"
 * @versions {"tool":"1.24.0+4110"}
 */

/**
 * Import the modules used in this configuration.
 */
const ADC12  = scripting.addModule("/ti/driverlib/ADC12", {}, false);
const ADC121 = ADC12.addInstance();
const Board  = scripting.addModule("/ti/driverlib/Board");
const GPIO   = scripting.addModule("/ti/driverlib/GPIO", {}, false);
const GPIO1  = GPIO.addInstance();
const SYSCTL = scripting.addModule("/ti/driverlib/SYSCTL");
const TIMER  = scripting.addModule("/ti/driverlib/TIMER", {}, false);
const TIMER1 = TIMER.addInstance();

/**
 * Write custom configuration values to the imported modules.
 */
ADC121.sampClkSrc          = "DL_ADC12_CLOCK_ULPCLK";
ADC121.sampClkDiv          = "DL_ADC12_CLOCK_DIVIDE_8";
ADC121.powerDownMode       = "DL_ADC12_POWER_DOWN_MODE_MANUAL";
ADC121.endAdd              = 3;
ADC121.adcMem1chansel      = "DL_ADC12_INPUT_CHAN_2";
ADC121.adcMem1stime        = "DL_ADC12_SAMPLE_TIMER_SOURCE_SCOMP1";
ADC121.adcMem2chansel      = "DL_ADC12_INPUT_CHAN_2";
ADC121.adcMem3chansel      = "DL_ADC12_INPUT_CHAN_2";
ADC121.adcMem3stime        = "DL_ADC12_SAMPLE_TIMER_SOURCE_SCOMP1";
ADC121.sampleTime0         = "25 us";
ADC121.sampleTime1         = "12.5 us";
ADC121.enabledInterrupts   = ["DL_ADC12_INTERRUPT_MEM3_RESULT_LOADED"];
ADC121.subChanID           = 1;
ADC121.$name               = "ADC1";
ADC121.adcMem10_name       = "ADC_Channel10";
ADC121.enabledADCMems      = [0];
ADC121.adcMem0_name        = "ADC_Channel0";
ADC121.peripheral.$assign  = "ADC0";
ADC121.adcPin0Config.$name = "ti_driverlib_gpio_GPIOPinGeneric0";


GPIO1.port                    = "PORTB";
GPIO1.$name                   = "Gray_Address";
GPIO1.associatedPins.create(3);
GPIO1.associatedPins[0].$name = "PIN_0";
GPIO1.associatedPins[1].$name = "PIN_1";
GPIO1.associatedPins[2].$name = "PIN_2";

SYSCTL.forceDefaultClkConfig = true;
SYSCTL.clockTreeEn           = true;

TIMER1.$name                       = "TIMER_0";
TIMER1.timerClkSrc                 = "LFCLK";
TIMER1.timerClkPrescale            = 9;
TIMER1.timerPeriod                 = "1.125 s";
TIMER1.event1PublisherChannel      = 1;
TIMER1.event1ControllerInterruptEn = ["ZERO_EVENT"];
TIMER1.peripheral.$assign          = "TIMG0";

/**
 * Pinmux solution for unlocked pins/peripherals. This ensures that minor changes to the automatic solver in a future
 * version of the tool will not impact the pinmux you originally saw.  These lines can be completely deleted in order to
 * re-solve from scratch.
 */
ADC121.peripheral.adcPin0.$suggestSolution   = "PA27";
Board.peripheral.$suggestSolution            = "DEBUGSS";
Board.peripheral.swclkPin.$suggestSolution   = "PA20";
Board.peripheral.swdioPin.$suggestSolution   = "PA19";
GPIO1.associatedPins[0].pin.$suggestSolution = "PB15";
GPIO1.associatedPins[1].pin.$suggestSolution = "PB14";
GPIO1.associatedPins[2].pin.$suggestSolution = "PB13";
